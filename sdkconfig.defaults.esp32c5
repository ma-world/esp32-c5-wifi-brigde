## sdkconfig.defaults.esp32c5
```kconfig
CONFIG_EXAMPLE_WIRED_INTERFACE_IS_ETHERNET=y
CONFIG_ESPTOOLPY_FLASHSIZE_16MB=y
CONFIG_PARTITION_TABLE_CUSTOM=y
CONFIG_PARTITION_TABLE_CUSTOM_FILENAME="partitions.csv"
CONFIG_EXAMPLE_WIFI_CONFIGURATION_MANUAL=y
CONFIG_EXAMPLE_USE_SPI_ETHERNET=y
CONFIG_EXAMPLE_USE_W5500=y
CONFIG_EXAMPLE_SPI_ETHERNETS_NUM=1
CONFIG_EXAMPLE_ETH_SPI_HOST=1
CONFIG_EXAMPLE_ETH_SPI_SCLK_GPIO=8
CONFIG_EXAMPLE_ETH_SPI_MOSI_GPIO=10
CONFIG_EXAMPLE_ETH_SPI_MISO_GPIO=9
CONFIG_EXAMPLE_ETH_SPI_CS0_GPIO=3
CONFIG_EXAMPLE_ETH_SPI_INT0_GPIO=4
CONFIG_EXAMPLE_ETH_SPI_PHY_RST0_GPIO=24
CONFIG_EXAMPLE_ETH_SPI_CLOCK_MHZ=16
CONFIG_EXAMPLE_RECONFIGURE_BUTTON=28
CONFIG_EXAMPLE_MODIFY_DHCP_MESSAGES=y
```
